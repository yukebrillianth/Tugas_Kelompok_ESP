## common/Kconfig.projbuild
```kconfig
menu "LED RGB"

    config RGB_LED_GPIO
        int "GPIO LED RGB (WS2812)"
        range 0 48
        default 48
        help
            ESP32-S3 DevKitC-1 memakai WS2812 di GPIO 48. Sesuaikan dengan papanmu.

endmenu
```

## node1_pump_server/main/Kconfig.projbuild
```kconfig
menu "Pompa"

    config PUMP_GPIO
        int "GPIO relay pompa"
        range 0 21
        default 5
        help
            ESP32-C3 hanya punya GPIO 0-21. Hindari GPIO 2, 8, 9 (strapping)
            dan 18, 19 (USB).

    config PUMP_ACTIVE_HIGH
        bool "Relay aktif HIGH"
        default y
        help
            Matikan jika modul relay aktif LOW.

endmenu
```

## node2_sensor_lpn/main/Kconfig.projbuild
```kconfig
menu "Sensor DHT11"

    config DHT11_GPIO
        int "GPIO data DHT11"
        range 0 48
        default 4

    config SENSOR_PERIOD_S
        int "Periode baca sensor (detik)"
        range 2 3600
        default 10
        help
            DHT11 butuh jeda minimal 1 detik antar pembacaan.

endmenu
```

## node2_sensor_lpn/sdkconfig.defaults
```kconfig
CONFIG_ESPTOOLPY_FLASHSIZE_16MB=y
CONFIG_PARTITION_TABLE_SINGLE_APP_LARGE=y

CONFIG_BT_ENABLED=y
CONFIG_BT_BTU_TASK_STACK_SIZE=4512
CONFIG_BT_CTRL_DFT_TX_POWER_LEVEL_P20=y
CONFIG_BT_CTRL_BLE_MESH_SCAN_DUPL_EN=y
CONFIG_BT_CTRL_SCAN_DUPL_TYPE_DATA_DEVICE=y
CONFIG_BT_BLE_42_FEATURES_SUPPORTED=y
CONFIG_BT_BLE_50_FEATURES_SUPPORTED=n

CONFIG_BLE_MESH=y
CONFIG_BLE_MESH_NODE=y
CONFIG_BLE_MESH_PB_GATT=y
CONFIG_BLE_MESH_GATT_PROXY_SERVER=n
CONFIG_BLE_MESH_RELAY=n
CONFIG_BLE_MESH_LOW_POWER=y
CONFIG_BLE_MESH_SETTINGS=y
CONFIG_BLE_MESH_MSG_CACHE_SIZE=32
CONFIG_BLE_MESH_CRPL=32
```

## node4_gateway_prov/main/Kconfig.projbuild
```kconfig
menu "Gateway Wi-Fi dan MQTT"

    config GW_WIFI_SSID
        string "SSID Wi-Fi"
        default "NAMA_WIFI"

    config GW_WIFI_PASSWORD
        string "Password Wi-Fi"
        default ""

    config GW_MQTT_URI
        string "URI broker MQTT"
        default "mqtt://192.168.1.10:1883"
        help
            IP komputer yang menjalankan Mosquitto, port 1883.

endmenu

menu "Kontrol pompa"

    config PUMP_ON_TEMP
        int "Suhu pompa ON (C)"
        default 29
        help
            Pompa ON saat suhu >= nilai ini.

    config PUMP_OFF_TEMP
        int "Suhu pompa OFF (C)"
        default 27
        help
            Pompa OFF saat suhu < nilai ini. Default 27 C (histeresis 2 C)
            supaya pompa tidak mati/nyala sendiri akibat fluktuasi 1 C DHT11.

    config PUMP_MIN_HOLD_S
        int "Durasi tahan minimum status pompa (detik)"
        range 0 300
        default 15
        help
            Jeda minimum sebelum mode auto boleh membalik status pompa.
            Isi 0 untuk menonaktifkan.

endmenu
```
